## sdkconfig.defaults
```kconfig
CONFIG_ESPTOOLPY_FLASHSIZE_4MB=y

# Use a custom partition table
CONFIG_PARTITION_TABLE_CUSTOM=y
CONFIG_PARTITION_TABLE_FILENAME="partitions.csv"
CONFIG_PARTITION_TABLE_OFFSET=0xC000

#enable BT
CONFIG_BT_ENABLED=y
CONFIG_BT_NIMBLE_ENABLED=y

#disable BT connection reattempt
CONFIG_BT_NIMBLE_ENABLE_CONN_REATTEMPT=n

#enable lwip ipv6 autoconfig
CONFIG_LWIP_IPV6_AUTOCONFIG=y


#enable lwIP route hooks
CONFIG_LWIP_HOOK_IP6_ROUTE_DEFAULT=y
CONFIG_LWIP_HOOK_ND6_GET_GW_DEFAULT=y

# Button
CONFIG_BUTTON_PERIOD_TIME_MS=20
CONFIG_BUTTON_LONG_PRESS_TIME_MS=5000

# disable softap by default
CONFIG_ESP_WIFI_SOFTAP_SUPPORT=n

# Enable HKDF in mbedtls
CONFIG_MBEDTLS_HKDF_C=y

# Increase LwIP IPv6 address number to 6 (MAX_FABRIC + 1)
# unique local addresses for fabrics(MAX_FABRIC), a link local address(1)
CONFIG_LWIP_IPV6_NUM_ADDRESSES=6

# This example only use 4 dynamic endpoints
CONFIG_ESP_MATTER_MAX_DYNAMIC_ENDPOINT_COUNT=4

# ESP32-DevKitC Settings
# Buttons
CONFIG_BSP_BUTTONS_NUM=1
CONFIG_BSP_BUTTON_1_TYPE_GPIO=y
CONFIG_BSP_BUTTON_1_GPIO=0
CONFIG_BSP_BUTTON_1_LEVEL=0

# Enable OTA Requestor
CONFIG_ENABLE_OTA_REQUESTOR=y

CONFIG_BLINK_LED_GPIO=y
CONFIG_BLINK_GPIO=8

CONFIG_OPENTHREAD_MTD=y
CONFIG_OPENTHREAD_FTD=n

# Thread Device Type
CONFIG_OPENTHREAD_DEVICE_TYPE_SED=y

# Polling - Use 30 seconds to match the code
CONFIG_OPENTHREAD_POLL_PERIOD=30000

# Child supervision (prevents "unavailable")
CONFIG_OPENTHREAD_CHILD_SUPERVISION_ENABLE=y
CONFIG_OPENTHREAD_CHILD_SUPERVISION_INTERVAL=129
CONFIG_OPENTHREAD_CHILD_SUPERVISION_CHECK_TIMEOUT=190

# Watchdog - increase for stability
CONFIG_ESP_TASK_WDT_TIMEOUT_S=15
```
